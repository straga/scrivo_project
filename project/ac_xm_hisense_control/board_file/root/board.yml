## project/ac_xm_hisense_control/board_file/root/board.yml
```yaml
board:
  - name: "g12_hisense"

pin:
  - id: status_output
    platform: gpio
    mode: OUT
    #inverted: True
    pin: 15

led-status:
  - platform: blink
    pin: status_output
    value: 0

wifi:
  runner:
    #- safe: False
  networks:
    - ssid: !secret iot_ssid
      password: !secret iot_password
    - ssid: !secret home_ssid
      password: !secret home_password


mqtt:
  - name: "bunker"
    addr: "192.168.100.240"
    port: 1883
    topic: "dev/g12_hisense"
    birth: True
    lwt: True
    sub: []
    # buffer size for outgoing messages
    maxsize: 150


acxm:
  - name: "hisense"
    uart_id: 0
    uart_rx: 16
    uart_tx: 17
    uart_baudrate: 9600
    mode: "normal"
    debug: True

telemetry:
  runner:
    - debug: True
      maxsize: 2
  module:
    - board: True
      wifi: True
      acxm: True
```

## project/gate_cover/board_file/root/board.yml
```yaml
board:
  - name: "g12-gate"
    telemetry:

wifi:
  networks:
    - ssid: !secret iot_ssid
      password: !secret iot_password
    - ssid: !secret home_ssid
      password: !secret home_password

mqtt:
  - name: "bunker"
    addr: "192.168.100.240"
    port: 1883
    topic: "dev/g12-gate"
    birth: True
    lwt: True
    sub: []

pin:
  - id: r1_output
    platform: gpio
    mode: OUT
    pin: 27

  - id: r2_output
    platform: gpio
    mode: OUT
    pin: 14

  - id: status_output
    platform: gpio
    mode: OUT
    inverted: True
    pin: 13

switch:
  - platform: binary
    id: r1
    name: "Relay 1"
    pin: r1_output
    restore: "OFF"

  - platform: binary
    id: r2
    pin: r2_output
    name: "Relay 2"
    restore: "OFF"

  - platform: binary
    id: status
    pin: status_output
    name: "Status LED"
    restore: "OFF"

cover:
  - platform: relay_two
    id: gate
    name: "Gate"
    relay_1: r1
    relay_2: r2
    close_duration: 26

telemetry:
  - board: True
    wifi: True
    switch: True
    cover: True
```

## project/meter_modbus/board_file/root/board.yml
```yaml
board:
  - name: "g12-input_meter"
    telemetry:

pin:
  - id: status_output
    platform: gpio
    mode: OUT
    pin: 15

led-status:
  - platform: blink
    pin: status_output
    value: 0

wifi:
  runner:
    - safe: ["ftp", "telnet"]
  networks:
    - ssid: !secret iot_ssid
      password: !secret iot_password
    - ssid: !secret home_ssid
      password: !secret home_password

mqtt:
  - name: "local"
    addr: "192.168.0.2"
    port: 1883
    topic: "dev/g12-input-meter"
    birth: True
    lwt: True
    sub: []

input-meter:
  - name: "Input Meter"
    addr: 1


telemetry:
  - board: True
    wifi: True
    input-meter: True
```
